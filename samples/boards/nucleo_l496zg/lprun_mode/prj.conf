## CMakeLists.txt
```
cmake_minimum_required(VERSION 3.8.2)
include($ENV{ZEPHYR_BASE}/cmake/app/boilerplate.cmake NO_POLICY_SCOPE)
project(nucleo_l496zg_lprun_mode)

target_sources(app PRIVATE src/main.c src/clock.c)
```

## prj.conf
```kconfig
# CONFIG_SYS_POWER_MANAGEMENT=y
# CONFIG_SYS_POWER_LOW_POWER_STATE=y
#CONFIG_SYS_POWER_DEEP_SLEEP=y
#CONFIG_DEVICE_POWER_MANAGEMENT=y
#CONFIG_RTC=y
CONFIG_GPIO=y
```

## prj_tickless.conf
```kconfig
#CONFIG_ASSERT=y
#CONFIG_ASSERT_LEVEL=2
#CONFIG_NUM_COOP_PRIORITIES=29
#CONFIG_NUM_PREEMPT_PRIORITIES=40
#
#CONFIG_SYS_POWER_MANAGEMENT=y
#CONFIG_TICKLESS_KERNEL=y
#
#CONFIG_SYS_POWER_MANAGEMENT=y
#CONFIG_SYS_POWER_LOW_POWER_STATE=y
#CONFIG_SYS_POWER_DEEP_SLEEP=y
#CONFIG_DEVICE_POWER_MANAGEMENT=y
#CONFIG_RTC=y
CONFIG_GPIO=y
```

## src/main.c
```c
/*
 * Copyright (c) 2016 Intel Corporation.
 *
 * SPDX-License-Identifier: Apache-2.0
 */
#include "clock.h"

#include <zephyr.h>
#include <misc/printk.h>
#include <sys_clock.h>

#define SEC_TO_US(X) ((X) * 1000000)

typedef enum freq {
    FREQ_80MHZ,
    FREQ_40MHZ,
    FREQ_1MHZ,

    FREQ_MAX_NUM,
} freq_t;

static pll_config_t pll_hsi_cfg[FREQ_MAX_NUM] = {
    { LL_RCC_PLLSOURCE_HSI, LL_RCC_PLLM_DIV_2, 40, LL_RCC_PLLR_DIV_4 },/* 80MHz */
    { LL_RCC_PLLSOURCE_HSI, LL_RCC_PLLM_DIV_4, 20, LL_RCC_PLLR_DIV_2 },/* 40MHz */
};

#if defined(CONFIG_TIMER_READS_ITS_FREQUENCY_AT_RUNTIME)
extern int z_clock_hw_cycles_per_sec;
#endif

static void frequency_set(freq_t freq)
{
    pll_config_t *cfg = &pll_hsi_cfg[freq];

    /* Switch to HSI and disable PLL.
     * - Switching to HSI ensures that we have a SYSCLK source once we turn off
     *   the PLL
     * - PLL must be disabled before changing its configuration
     */
    clock_switch_to_hsi();

    clock_disable_msi();
    clock_disable_pll();

    /* Change PLL Configuration */
    clock_config_pll(cfg);

    /* Enable PLL */
    clock_enable_pll();

    /* Set PLL as SYSCLK source */
    clock_switch_to_pll();
}

static void cycle_frequencies(void)
{
    for (int i = 0; i < 5; i++) {
        switch (i % FREQ_MAX_NUM) {
            case FREQ_80MHZ:
                printk("Change to 80MHZ\n");
                frequency_set(FREQ_80MHZ);
                z_clock_hw_cycles_per_sec = 80000000;
                break;
            case FREQ_40MHZ:
                printk("Change to 40MHZ\n");
                frequency_set(FREQ_40MHZ);
                z_clock_hw_cycles_per_sec = 40000000;
                break;
            default:
                printk("Unhandled frequency\n");
                break;
        }
        printk("Busy wait for 10 secs.\n");
        k_busy_wait(SEC_TO_US(10));
    }
}

static void system_clock_config(void)
{
    clock_enable_hsi();
}

void main(void)
{
	printk("Power Management Demo on %s\n", CONFIG_ARCH);

    system_clock_config();

    cycle_frequencies();

	printk("**Power States test complete**\n");
}
```

## src/clock.c
```c
#include "clock.h"
#include <zephyr.h>

void clock_enable_hsi(void)
{
    if (LL_RCC_HSI_IsReady() != 1) {
        LL_RCC_HSI_Enable();

        while (LL_RCC_HSI_IsReady() != 1) {
            continue;
        }
    }
}

void clock_enable_msi(void)
{
    if (LL_RCC_MSI_IsReady() != 1) {
        LL_RCC_MSI_Enable();

        while (LL_RCC_MSI_IsReady() != 1) {
            continue;
        }
    }
}

void clock_enable_pll(void)
{
    if (LL_RCC_PLL_IsReady() != 1) {
        LL_RCC_PLL_Enable();
        while (LL_RCC_PLL_IsReady() != 1) {
            continue;
        }
    }
}

void clock_disable_hsi(void)
{
    if (LL_RCC_HSI_IsReady() != 0) {
        LL_RCC_HSI_Disable();

        while (LL_RCC_HSI_IsReady() != 0) {
            continue;
        }
    }
}

void clock_disable_msi(void)
{
    if (LL_RCC_MSI_IsReady() != 0) {
        LL_RCC_MSI_Disable();

        while (LL_RCC_MSI_IsReady() != 0) {
            continue;
        }
    }
}

void clock_disable_pll(void)
{
    if (LL_RCC_PLL_IsReady() != 0) {
        LL_RCC_PLL_Disable();
        while (LL_RCC_PLL_IsReady() != 0) {
            continue;
        }
    }
}

void clock_switch_to_hsi(void)
{
    /* Select HSI as system clock */
    LL_RCC_SetSysClkSource(LL_RCC_SYS_CLKSOURCE_HSI);

    while (LL_RCC_GetSysClkSource() != LL_RCC_SYS_CLKSOURCE_STATUS_HSI) {
        continue;
    }
}

void clock_switch_to_msi(void)
{
    /* Select MSI as system clock */
    LL_RCC_SetSysClkSource(LL_RCC_SYS_CLKSOURCE_MSI);

    while (LL_RCC_GetSysClkSource() != LL_RCC_SYS_CLKSOURCE_STATUS_MSI) {
        continue;
    }
}

void clock_switch_to_pll(void)
{
    /* Select PLL as system clock */
    LL_RCC_SetSysClkSource(LL_RCC_SYS_CLKSOURCE_PLL);

    while (LL_RCC_GetSysClkSource() != LL_RCC_SYS_CLKSOURCE_STATUS_PLL) {
        continue;
    }
}

void clock_config_pll(pll_config_t *cfg)
{
    switch (cfg->src) {
        case LL_RCC_PLLSOURCE_HSI:
            LL_RCC_PLL_ConfigDomain_SYS(cfg->src, cfg->m, cfg->n, cfg->r);
            break;
        default:
            printk("Unknown clk source\n");
            break;
    }
}
```

## src/clock.h
```c
#ifndef _CLOCK_H
#define _CLOCK_H

#include <inttypes.h>

typedef struct {
    uint32_t src;
    uint32_t m;
    uint32_t n;
    uint32_t r;
} pll_config_t;

/**
 * @brief Enable HSI
 */
extern void clock_enable_hsi(void);

/**
 * @brief Enable MSI
 */
extern void clock_enable_msi(void);

/**
 * @brief Enable PLL
 */
extern void clock_enable_pll(void);

/**
 * @brief Disable HSI
 */
extern void clock_disable_hsi(void);

/**
 * @brief Disable MSI
 */
extern void clock_disable_msi(void);

/**
 * @brief Disable PLL
 */
extern void clock_disable_pll(void);

/**
 * @brief Switch to HSI
 */
extern void clock_switch_to_hsi(void);

/**
 * @brief Switch to MSI
 */
extern void clock_switch_to_msi(void);

/**
 * @brief Switch to PLL
 */
extern void clock_switch_to_pll(void);

/**
 * @brief Configure PLL
 */
extern void clock_config_pll(pll_config_t *cfg);

#endif /* _CLOCK_H */
```
