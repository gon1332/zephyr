## sample.yaml
```
sample:
  name: Power management demo
tests:
  test:
    # filter: (CONFIG_SOC_QUARK_SE_C1000 or CONFIG_SOC_QUARK_SE_C1000_SS)
    tags: power
    depends_on: gpio
```

## prj.conf
```kconfig
CONFIG_GPIO=y
CONFIG_REBOOT=y
```

## src/main.c
```c
/*
 * Copyright (c) 2016 Intel Corporation.
 *
 * SPDX-License-Identifier: Apache-2.0
 */

#include <zephyr.h>
#include <misc/printk.h>
#include <misc/reboot.h>

void main(void)
{
	printk("Reset System Demo on %s\n", CONFIG_ARCH);

    // sys_reboot(0);
}
```
