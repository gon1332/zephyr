## CMakeLists.txt
```
cmake_minimum_required(VERSION 3.8.2)
include($ENV{ZEPHYR_BASE}/cmake/app/boilerplate.cmake NO_POLICY_SCOPE)
project(nucleo_l496zg_lprun_mode)

target_sources(app PRIVATE src/main.c src/power.c)
```

## Kconfig
```
config NRF5_POWER_MGMT_EXAMPLE
    bool
    default y
    select SYS_POWER_LOW_POWER_STATE_SUPPORTED
    select SYS_POWER_STATE_CPU_LPS_1_SUPPORTED
    select SYS_POWER_STATE_CPU_LPS_2_SUPPORTED

    help
        Hidden option enabling LPS_1 and LPS_2 low power states.
        This is needed, as these states are implemented by this example.

# Include Zephyr's Kconfig.
source "$ZEPHYR_BASE/Kconfig"
```

## prj.conf
```kconfig
CONFIG_REBOOT=n

CONFIG_SYS_POWER_MANAGEMENT=y
CONFIG_SYS_POWER_LOW_POWER_STATE=y
CONFIG_SYS_POWER_DEEP_SLEEP=y
CONFIG_DEVICE_POWER_MANAGEMENT=y

CONFIG_PM_CONTROL_OS=y
CONFIG_PM_POLICY_RESIDENCY=y
CONFIG_PM_LPS_1_MIN_RES=10
CONFIG_PM_DEEP_SLEEP_MIN_RES=60

CONFIG_GPIO=y
CONFIG_RTC=y
CONFIG_RTC_STM32_CLOCK_LSI=y
```

## src/main.c
```c
/*
 * Copyright (c) 2016 Intel Corporation.
 *
 * SPDX-License-Identifier: Apache-2.0
 */

#include "sample.h"
#include <gpio.h>

#define SEC_TO_US(X) ((X) * 1000000)

#define LPS1_STATE_ENTER_TO         10
#define LPS2_STATE_ENTER_TO         30
#define DEEP_SLEEP_STATE_ENTER_TO   90

struct device *gpiob;
struct device *gpioc;

void configure_gpio(void)
{
    gpioc = device_get_binding(PORT);
    gpiob = device_get_binding(LED_PORT);

    // /* Configure button 1 as deep sleep trigger event */
    // gpio_pin_configure(gpio_port, BUTTON_1, GPIO_DIR_IN
    //                                         | GPIO_PUD_PULL_UP);

    /* Configure button 2 as wake source from deep sleep */
    gpio_pin_configure(gpioc, BUTTON_2, GPIO_DIR_IN
                                        | GPIO_PUD_PULL_UP
                                        | GPIO_INT | GPIO_INT_EDGE
                                        | GPIO_INT_ACTIVE_HIGH);

    gpio_pin_enable_callback(gpioc, BUTTON_2);

    /* Configure LEDs */
    gpio_pin_configure(gpiob, LED_1, GPIO_DIR_OUT);
    gpio_pin_write(gpiob, LED_1, LED_ON);

    gpio_pin_configure(gpiob, LED_2, GPIO_DIR_OUT);
    gpio_pin_write(gpiob, LED_2, LED_ON);
}

void main(void)
{
    uint32_t level = 0U;

	printk("Power Management Demo on %s\n", CONFIG_ARCH);

            /* Enable Power Peripheral */
            LL_APB1_GRP1_EnableClock(LL_APB1_GRP1_PERIPH_PWR);

            if (LL_PWR_IsActiveFlag_SB() != 0) {
                printk("SoC resumed from STANDBY.\n");
                LL_PWR_ClearFlag_SB();
            }

            if (LL_PWR_IsActiveFlag_WU2() != 0) {
                printk("WU2 was active.\n");
                LL_PWR_ClearFlag_WU2();
            }

    configure_gpio();

    printk("\n<-- App doing busy wait for 5 Sec -->\n");
    k_busy_wait(SEC_TO_US(5));

    /*
     * Start the demo.
     */
    // for (int i = 1; i <= 4; i++) {
    //     printk("\n<-- App doing busy wait for 10 Sec -->\n");
    //     k_busy_wait(SEC_TO_US(10));

    //     /* Create Idleness to make Idle thread run */
    //     if ((i % 2) == 0) {
    //         printk("\n<-- App going to sleep for %u Sec -->\n",
    //                LPS2_STATE_ENTER_TO);
    //         k_sleep(K_SECONDS(LPS2_STATE_ENTER_TO));
    //     } else {
    //         printk("\n<-- App going to sleep for %u Sec -->\n",
    //                LPS1_STATE_ENTER_TO);
    //         k_sleep(K_SECONDS(LPS1_STATE_ENTER_TO));
    //     }
    // }

    printk("\nPress BUTTON1 to enter into Deep Sleep state. "
            "Press BUTTON2 to exit Deep Sleep state\n");
    k_sleep(K_SECONDS(DEEP_SLEEP_STATE_ENTER_TO));

    while (1) {
        continue;
    }
}
```

## src/power.c
```c
#include "sample.h"

/*
 * Application defined function for doing any target specific operations
 * for low power entry.
 */
void sys_pm_notify_lps_entry(enum power_states state)
{
    switch (state) {
    case SYS_POWER_STATE_CPU_LPS_1:
        printk("--> Entering to SYS_POWER_STATE_CPU_LPS_1 state.\n");

        /*
         * This power state is implemented by this sample.
         * Perform enter to the low power state by turning off LED2.
         */
        gpio_pin_write(gpiob, LED_1, LED_ON);
        gpio_pin_write(gpiob, LED_2, LED_OFF);
        k_cpu_idle();
        break;

    case SYS_POWER_STATE_CPU_LPS_2:
        printk("--> Entering to SYS_POWER_STATE_CPU_LPS_2 state.\n");

        /*
         * This power state is implemented by this sample.
         * Perform enter to the low power state by turning off LEDs.
         */
        gpio_pin_write(gpiob, LED_1, LED_OFF);
        gpio_pin_write(gpiob, LED_2, LED_OFF);
        k_cpu_idle();
        break;

    case SYS_POWER_STATE_DEEP_SLEEP:
        printk("--> Entering to SYS_POWER_STATE_DEEP_SLEEP state.\n");

        /*
         * This power mode is already implemented by the OS. It will be
         * handled by SoC-specific code. Here we just turn off the LEDs
         * to save power.
         */
        gpio_pin_write(gpiob, LED_1, LED_OFF);
        gpio_pin_write(gpiob, LED_2, LED_OFF);

        /* Nothing else to do */
        break;

    default:
        printk("Unsupported power state %u", state);
        break;
    }
}

/*
 * Application defined function for doing any target specific operations
 * for low power exit.
 */
void sys_pm_notify_lps_exit(enum power_states state)
{
    switch (state) {
    case SYS_POWER_STATE_CPU_LPS_1:
        printk("--> Exited from SYS_POWER_STATE_CPU_LPS_1 state.\n");

        /* Perform exit from the low power state by turning on LEDs */
        gpio_pin_write(gpiob, LED_1, LED_ON);
        gpio_pin_write(gpiob, LED_2, LED_ON);
        break;

    case SYS_POWER_STATE_CPU_LPS_2:
        printk("--> Exited from SYS_POWER_STATE_CPU_LPS_2 state.\n");

        /* Perform exit from the low power state by turning on LEDs */
        gpio_pin_write(gpiob, LED_1, LED_ON);
        gpio_pin_write(gpiob, LED_2, LED_ON);
        break;

    case SYS_POWER_STATE_DEEP_SLEEP:
        printk("--> Exited from SYS_POWER_STATE_DEEP_SLEEP state.\n");

        /* Turn on LEDs which were powered down before deep sleep. */
        gpio_pin_write(gpiob, LED_1, LED_ON);
        gpio_pin_write(gpiob, LED_2, LED_ON);
        break;

    default:
        printk("Unsupported power state %u", state);
        break;
    }
}
```

## src/sample.h
```c
#include <zephyr.h>
#include <string.h>
#include <soc.h>
#include <device.h>
#include <gpio.h>
#include <misc/printk.h>

/* change this to use another GPIO port */
#define PORT        SW0_GPIO_CONTROLLER
// #define BUTTON_1    SW0_GPIO_PIN
#define BUTTON_2    SW0_GPIO_PIN
#define LED_PORT    LED1_GPIO_CONTROLLER
#define LED_1       LED1_GPIO_PIN
#define LED_2       LED2_GPIO_PIN

#define LOW         0
#define HIGH        1
#define LED_ON      HIGH
#define LED_OFF     LOW

extern struct device *gpiob;
```
